## conf/layer.conf
```bitbake
# We have a conf and classes directory, add to BBPATH
BBPATH .= ":${LAYERDIR}"

# We have recipes-* directories, add to BBFILES
BBFILES += "${LAYERDIR}/recipes-*/*/*.bb \
            ${LAYERDIR}/recipes-*/*/*.bbappend"

BBFILE_COLLECTIONS += "iwave-layer"
BBFILE_PATTERN_iwave-layer = "^${LAYERDIR}/"
BBFILE_PRIORITY_iwave-layer = "9"

LAYERSERIES_COMPAT_iwave-layer = "sumo"
```

## conf/machine/imx8mn_iwg37m.conf
```bitbake
#@TYPE: Machine
#@NAME: iWave iW-RainboW-G37M-i.MX8M Nano SODIMM Development Kit
#@SOC: i.MX8MN
#@DESCRIPTION: Machine configuration for iWave iW-RainboW-G37M-i.MX8M Nano SODIMM Board
#@MAINTAINER: iWave Systems Technologies Pvt. Ltd.

MACHINEOVERRIDES =. "mx8:mx8m:mx8mn:"

#require conf/distro/include/fsl-imx-preferred-env-iw.inc
require conf/machine/include/imx-base.inc
require conf/machine/include/arm/arch-arm64.inc

MACHINE_FEATURES += " pci wifi bluetooth optee bcm43455 bcm4356 bcm4359"

# Device tree for i.MX8MN IWG37M
KERNEL_DEVICETREE = "freescale/fsl-imx8mn-iwg37m.dtb"

UBOOT_CONFIG ??= "sd"
UBOOT_CONFIG[sd] = "imx8mn_iwg37m_defconfig,sdcard"
SPL_BINARY = "spl/u-boot-spl.bin"

PREFERRED_PROVIDER_virtual/bootloader_mx8mn = "u-boot-iwg37m"
PREFERRED_PROVIDER_virtual/kernel_mx8mn = "linux-iwg37m"

# Set DDR FIRMWARE
DDR_FIRMWARE_NAME = "lpddr4_pmu_train_1d_imem.bin lpddr4_pmu_train_1d_dmem.bin lpddr4_pmu_train_2d_imem.bin lpddr4_pmu_train_2d_dmem.bin"

# Set u-boot DTB
UBOOT_DTB_NAME = "fsl-imx8mn-iwg37m.dtb"

IMAGE_INSTALL_append = " iwtest obexftp dhcpcd dnsmasq gstreamer1.0-libav "
CORE_IMAGE_EXTRA_INSTALL += "gstreamer1.0-plugins-ugly-meta packagegroup-fsl-gstreamer1.0-commercial "
#ffmpeg"
CORE_IMAGE_EXTRA_INSTALL += "gstreamer1.0-plugins-ugly"
LICENSE_FLAGS_WHITELIST = "commercial"

# Set imx-mkimage boot target
IMXBOOT_TARGETS = "${@bb.utils.contains('UBOOT_CONFIG', 'sd', 'flash_iwg37m', '', d)}"

SERIAL_CONSOLES = "115200;ttymxc3"

IMAGE_BOOTLOADER = "imx-boot"

BOOT_SPACE = "65536"

LOADADDR = ""
UBOOT_SUFFIX = "bin"
UBOOT_MAKE_TARGET = ""
IMX_BOOT_SEEK = "32"
```
